## cam_tester/sdkconfig.defaults
```kconfig
# ESP32-P4 Camera Tester — Default sdkconfig

# --- Console UART ---
# Boot at 2 Mbaud so the viewer connects at a single fixed rate.
# No runtime baudrate switch is needed; the viewer discards boot noise
# via the frame-header sync before processing any frame data.
CONFIG_ESP_CONSOLE_UART_DEFAULT=y
CONFIG_ESP_CONSOLE_UART_BAUDRATE=2000000

# --- SPIRAM ---
CONFIG_SPIRAM=y
CONFIG_SPIRAM_MODE_OCT=y
CONFIG_SPIRAM_SPEED_200M=y
CONFIG_SPIRAM_FETCH_INSTRUCTIONS=y
CONFIG_SPIRAM_RODATA=y

# --- OV5647 Camera Sensor ---
CONFIG_CAMERA_OV5647=y
CONFIG_CAMERA_OV5647_AUTO_DETECT_MIPI_INTERFACE_SENSOR=y
CONFIG_CAMERA_OV5647_MIPI_RAW8_800X640_50FPS=y
CONFIG_CAMERA_OV5647_MIPI_RAW8_800X800_50FPS=y
CONFIG_CAMERA_OV5647_MIPI_DEFAULT_FMT_RAW8_800X640_50FPS=y
CONFIG_CAMERA_OV5647_CSI_LINESYNC_ENABLE=y

# --- Stack ---
# Extra headroom for uart_driver_install and double-buffer bookkeeping
CONFIG_ESP_MAIN_TASK_STACK_SIZE=16384

# --- Logging ---
CONFIG_LOG_DEFAULT_LEVEL_INFO=y
```

## claude_cam_test/sdkconfig.defaults
```kconfig
# ── Console UART ──────────────────────────────────────────────────────────────
# Must be set here, not at runtime.  A runtime baud-rate change leaves garbage
# bytes in the TX FIFO that get sent at the wrong rate, corrupting the stream.
CONFIG_ESP_CONSOLE_UART_BAUDRATE=2000000

# ── SPIRAM ────────────────────────────────────────────────────────────────────
# Frame buffers for 800x640 RGB565 are ~1 MB; SPIRAM is required.
CONFIG_SPIRAM=y
CONFIG_SPIRAM_USE_MALLOC=y
CONFIG_SPIRAM_SPEED_80M=y

# ── Stack / heap ──────────────────────────────────────────────────────────────
CONFIG_ESP_MAIN_TASK_STACK_SIZE=8192

# ── Reduce log noise on UART0 during development ──────────────────────────────
CONFIG_LOG_DEFAULT_LEVEL_INFO=y
```
